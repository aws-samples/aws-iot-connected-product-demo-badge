## firmware/boards/arm/demo_badge_2023/Kconfig
```kconfig
# Copyright Amazon.com, Inc. or its affiliates. All Rights Reserved.
# SPDX-License-Identifier: MIT-0

if BOARD_DEMO_BADGE_2023

config BOARD_ENABLE_DCDC
	bool "DCDC mode"
	select SOC_DCDC_NRF52X
	default y

config BOARD_ENABLE_DCDC_HV
	bool "High Voltage DCDC converter"
	select SOC_DCDC_NRF52X_HV
	default y

endif # BOARD_DEMO_BADGE_2023
```

## firmware/boards/arm/demo_badge_2023/Kconfig.board
```kconfig
# Copyright Amazon.com, Inc. or its affiliates. All Rights Reserved.
# SPDX-License-Identifier: MIT-0

config BOARD_DEMO_BADGE_2023
	bool "AWS IoT Connected Product Demo Badge 2023"
	depends on SOC_NRF52840_QIAA
```

## firmware/boards/arm/demo_badge_2023/Kconfig.defconfig
```kconfig
# Copyright Amazon.com, Inc. or its affiliates. All Rights Reserved.
# SPDX-License-Identifier: MIT-0

if BOARD_DEMO_BADGE_2023

config BOARD
	default "demo_badge_2023"

config BT_CTLR
	default BT

endif # BOARD_DEMO_BADGE_2023
```

## firmware/boards/arm/demo_badge_2023/demo_badge_2023_defconfig
```kconfig
# Copyright Amazon.com, Inc. or its affiliates. All Rights Reserved.
# SPDX-License-Identifier: MIT-0

CONFIG_SOC_SERIES_NRF52X=y
CONFIG_SOC_NRF52840_QIAA=y

# Custom board definition
CONFIG_BOARD_DEMO_BADGE_2023=y

# Enable MPU
CONFIG_ARM_MPU=y

# Enable hardware stack protection
CONFIG_HW_STACK_PROTECTION=y
```
